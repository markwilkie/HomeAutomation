// File generated 8/11/2024 2:41:48 PM
// Warning! This is a generated file, any manual changes will be
// lost during the next generation.

#constant  Strings2Count    1
#constant  Strings2Size     17
#constant  Strings0Count    1
#constant  Strings0Size     22
#constant  Strings4Count    1
#constant  Strings4Size     6
#constant  Strings5Count    1
#constant  Strings5Size     6
#constant  Strings7Count    1
#constant  Strings7Size     14
#constant  Strings9Count    1
#constant  Strings9Size     11
#constant  Strings37Count    1
#constant  Strings37Size     8
#constant  Strings38Count    1
#constant  Strings38Size     6
#constant  Strings10Count    1
#constant  Strings10Size     6
#constant  Strings11Count    1
#constant  Strings11Size     15
#constant  Strings12Count    1
#constant  Strings12Size     17
#constant  Strings15Count    1
#constant  Strings15Size     13
#constant  Strings16Count    1
#constant  Strings16Size     13
#constant  Strings18Count    1
#constant  Strings18Size     5
#constant  Strings19Count    1
#constant  Strings19Size     5
#constant  Strings20Count    1
#constant  Strings20Size     5
#constant  Strings21Count    1
#constant  Strings21Size     7
#constant  Strings22Count    1
#constant  Strings22Size     13
#constant  Strings23Count    1
#constant  Strings23Size     7
#constant  Strings24Count    1
#constant  Strings24Size     12
#constant  Strings13Count    1
#constant  Strings13Size     7
#constant  Strings14Count    1
#constant  Strings14Size     16
#constant  Strings25Count    1
#constant  Strings25Size     7
#constant  Strings26Count    1
#constant  Strings26Size     17
#constant  Strings17Count    1
#constant  Strings17Size     5
#constant  Strings3Count    1
#constant  Strings3Size     5
#constant  Strings6Count    1
#constant  Strings6Size     12
#constant  Strings27Count    1
#constant  Strings27Size     3
#constant  Strings28Count    1
#constant  Strings28Size     8
#constant  Strings8Count    1
#constant  Strings8Size     13
#constant  Strings29Count    1
#constant  Strings29Size     5
#constant  Strings30Count    1
#constant  Strings30Size     5
#constant  Strings31Count    1
#constant  Strings31Size     13
#constant  Strings1Count    1
#constant  Strings1Size     12
#constant  Strings32Count    1
#constant  Strings32Size     7
#constant  Strings33Count    1
#constant  Strings33Size     13
#constant  Strings34Count    0
#constant  Strings34Size     1
#constant  Strings35Count    1
#constant  Strings35Size     17
#constant  Strings36Count    0
#constant  Strings36Size     1
#constant  Strings39Count    1
#constant  Strings39Size     11
#constant  IFONT_OFFSET     40
// object indexes into WIDGET pointer
#CONST
    iIAngularMeter0
    iIAngularMeter1
    iIAngularMeter3
    iILedDigits1
    iILedDigits2
    iILedDigits3
    iIAngularMeter2
    iILedDigits4
    iILedDigits6
    iILedDigits7
    iILedDigits8
    iILedDigits5
    iILedDigits9
    iILedDigits0
#END

// object indexes into ImageControl
#CONST
    iImage0         // offset 0x0
    iGauge0         // offset 0x400
    iImage1         // offset 0xC600
    iImage3         // offset 0xCA00
    iImage4         // offset 0xCE00
    iImage6         // offset 0xD400
    iImage5         // offset 0xDA00
    iImage7         // offset 0xE000
    iImage8         // offset 0xE600
    iImage9         // offset 0xEC00
    iGauge1         // offset 0xF400
    iGauge2         // offset 0x13200
    iGauge3         // offset 0x17000
    iImage10        // offset 0x23200
    iUserbutton1    // offset 0x23600
    iUserled0       // offset 0x24A00
    iUserbutton0    // offset 0x25000
    iUserbutton5    // offset 0x26600
    iUserbutton3    // offset 0x27A00
    iUserbutton8    // offset 0x28800
    iUserbutton10   // offset 0x26600
    iUserbutton4    // offset 0x25000
    iWinbutton0     // offset 0x29C00
    iWinbutton1     // offset 0x31800
    iUserbutton11   // offset 0x26600
    iUserbutton6    // offset 0x25000
    iUserbutton7    // offset 0x26600
    iForm5          // offset 0x39400
    iUserbutton9    // offset 0x25000
    iWinbutton2     // offset 0x57600
    iWinbutton3     // offset 0x5F200
    iWinbutton4     // offset 0x29C00
    iWinbutton5     // offset 0x31800
    iUserbutton2    // offset 0x23600
    iFontStrings2
    iFontStrings10
    iFontStrings8
    iFontStrings39
    iTextStrings
#END


#constant  Strings2StartH   0x0
#constant  Strings2StartL   0x0
#constant  Strings0StartH   0x0
#constant  Strings0StartL   0x200
#constant  Strings4StartH   0x0
#constant  Strings4StartL   0x400
#constant  Strings5StartH   0x0
#constant  Strings5StartL   0x600
#constant  Strings7StartH   0x0
#constant  Strings7StartL   0x800
#constant  Strings9StartH   0x0
#constant  Strings9StartL   0xA00
#constant  Strings37StartH   0x0
#constant  Strings37StartL   0xC00
#constant  Strings38StartH   0x0
#constant  Strings38StartL   0xE00
#constant  Strings10StartH   0x0
#constant  Strings10StartL   0x1000
#constant  Strings11StartH   0x0
#constant  Strings11StartL   0x1200
#constant  Strings12StartH   0x0
#constant  Strings12StartL   0x1400
#constant  Strings15StartH   0x0
#constant  Strings15StartL   0x1600
#constant  Strings16StartH   0x0
#constant  Strings16StartL   0x1800
#constant  Strings18StartH   0x0
#constant  Strings18StartL   0x1A00
#constant  Strings19StartH   0x0
#constant  Strings19StartL   0x1C00
#constant  Strings20StartH   0x0
#constant  Strings20StartL   0x1E00
#constant  Strings21StartH   0x0
#constant  Strings21StartL   0x2000
#constant  Strings22StartH   0x0
#constant  Strings22StartL   0x2200
#constant  Strings23StartH   0x0
#constant  Strings23StartL   0x2400
#constant  Strings24StartH   0x0
#constant  Strings24StartL   0x2600
#constant  Strings13StartH   0x0
#constant  Strings13StartL   0x2800
#constant  Strings14StartH   0x0
#constant  Strings14StartL   0x2A00
#constant  Strings25StartH   0x0
#constant  Strings25StartL   0x2C00
#constant  Strings26StartH   0x0
#constant  Strings26StartL   0x2E00
#constant  Strings17StartH   0x0
#constant  Strings17StartL   0x3000
#constant  Strings3StartH   0x0
#constant  Strings3StartL   0x3200
#constant  Strings6StartH   0x0
#constant  Strings6StartL   0x3400
#constant  Strings27StartH   0x0
#constant  Strings27StartL   0x3600
#constant  Strings28StartH   0x0
#constant  Strings28StartL   0x3800
#constant  Strings8StartH   0x0
#constant  Strings8StartL   0x3A00
#constant  Strings29StartH   0x0
#constant  Strings29StartL   0x3C00
#constant  Strings30StartH   0x0
#constant  Strings30StartL   0x3E00
#constant  Strings31StartH   0x0
#constant  Strings31StartL   0x4000
#constant  Strings1StartH   0x0
#constant  Strings1StartL   0x4200
#constant  Strings32StartH   0x0
#constant  Strings32StartL   0x4400
#constant  Strings33StartH   0x0
#constant  Strings33StartL   0x4600
#constant  Strings34StartH   0x0
#constant  Strings34StartL   0x4800
#constant  Strings35StartH   0x0
#constant  Strings35StartL   0x4A00
#constant  Strings36StartH   0x0
#constant  Strings36StartL   0x4C00
#constant  Strings39StartH   0x0
#constant  Strings39StartL   0x4E00

#constant  ffsEndUnits4k    0x0078  // First unused 4k Sector on Flash
#constant  ffsEnd4kH        0x0007  // Address of first unused 4k Sector on Flash, High
#constant  ffsEnd4kL        0x8000  // Address of first unused 4k Sector on Flash, Low
#constant  ffsEndUnits32k   0x000F  // First unused 32k Block on Flash
#constant  ffsEnd32kH       0x0007  // Address of first unused 32k Block on Flash, High
#constant  ffsEnd32kL       0x8000  // Address of first unused 32k Block on Flash, Low
#constant  ffsEndUnits64k   0x0008  // First unused 64k Block on Flash
#constant  ffsEnd64kH       0x0008  // Address of first unused 64k Block on Flash, High
#constant  ffsEnd64kL       0x0000  // Address of first unused 64k Block on Flash, Low

#IFNOT EXISTS NOGLOBALS
var hndl ;
#ENDIF
