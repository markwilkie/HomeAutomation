// File generated 8/11/2024 2:36:01 PM
// Warning! This is a generated file, any manual changes will be
// lost during the next generation.

#constant  IFONT_OFFSET     0
// object indexes into WIDGET pointer
#CONST
    iIAngularMeter0
    iIAngularMeter1
    iILedDigits0
    iIAngularMeter3
#END

// object indexes into ImageControl
#CONST
    iCustomdigits0  // offset 0x0
    iiCustomdigits0 // offset 0x600
    iAngularmeter0  // offset 0x1C00
    iCustomdigits1  // offset 0x600
    iiCustomdigits1 // offset 0x600
    iImage0         // offset 0x19D000
#END



#constant  ffsEndUnits4k    0x019D  // First unused 4k Sector on Flash
#constant  ffsEnd4kH        0x0019  // Address of first unused 4k Sector on Flash, High
#constant  ffsEnd4kL        0xD000  // Address of first unused 4k Sector on Flash, Low
#constant  ffsEndUnits32k   0x0034  // First unused 32k Block on Flash
#constant  ffsEnd32kH       0x001A  // Address of first unused 32k Block on Flash, High
#constant  ffsEnd32kL       0x0000  // Address of first unused 32k Block on Flash, Low
#constant  ffsEndUnits64k   0x001A  // First unused 64k Block on Flash
#constant  ffsEnd64kH       0x001A  // Address of first unused 64k Block on Flash, High
#constant  ffsEnd64kL       0x0000  // Address of first unused 64k Block on Flash, Low

#IFNOT EXISTS NOGLOBALS
var hndl ;
#ENDIF
