## DormerWindowState/main/Kconfig.projbuild
```kconfig
menu "Dormer Window State Configuration"

    config WINDOW_SENSOR_GPIO
        int "Window contact sensor GPIO pin"
        default 4
        range 0 30
        help
            Digital input GPIO connected to the reed switch / magnetic contact
            sensor mounted on the window and frame.

    config WINDOW_SENSOR_ACTIVE_LOW
        bool "Sensor reads LOW when window is closed"
        default y
        help
            Most reed switches short the pin to GND when the magnet is present
            (window closed), so with an internal pull-up the pin reads LOW when
            closed and HIGH when open. Disable this if your wiring is inverted
            (e.g. switch wired to 3.3V with a pull-down instead).

    config WINDOW_SENSOR_DEBOUNCE_MS
        int "Debounce time (milliseconds)"
        default 50
        range 5 1000
        help
            Time the pin level must remain stable after an edge before the
            new state is trusted and pushed to the Matter Boolean State
            attribute. Increase if the reed switch is mechanically noisy.

endmenu
```

## DormerWindowState/sdkconfig.defaults
```kconfig
# Target
CONFIG_IDF_TARGET="esp32c6"

# Partition table
CONFIG_PARTITION_TABLE_CUSTOM=y
CONFIG_PARTITION_TABLE_CUSTOM_FILENAME="partitions.csv"
CONFIG_PARTITION_TABLE_FILENAME="partitions.csv"
CONFIG_PARTITION_TABLE_OFFSET=0x8000

# Flash
CONFIG_ESPTOOLPY_FLASHSIZE_4MB=y
CONFIG_ESPTOOLPY_FLASHSIZE="4MB"

# BLE (used for Matter commissioning)
CONFIG_BT_ENABLED=y
CONFIG_BT_NIMBLE_ENABLED=y

# mbedTLS (required by the Matter stack)
CONFIG_MBEDTLS_CERTIFICATE_BUNDLE=y
CONFIG_MBEDTLS_PSK_MODES=y
# Matter's crypto layer (CHIPCryptoPALmbedTLS.cpp) calls mbedtls_hkdf
# directly; mbedTLS ships it disabled by default.
CONFIG_MBEDTLS_HKDF_C=y

# NVS encryption (commissioning/fabric credentials live here)
CONFIG_NVS_ENCRYPTION=y
# Default HMAC eFuse key ID (6) is out of nvs_sec_provider.c's accepted
# range (0-5) in IDF v5.4.1 -- Kconfig says "range 0 6" / "default 6" but
# the C code only allows 0-5. Pin to a valid block.
CONFIG_NVS_SEC_HMAC_EFUSE_KEY_ID=0

# Matter console (handy for diagnostics over serial)
CONFIG_ENABLE_CHIP_SHELL=y

# FreeRTOS / app
CONFIG_FREERTOS_HZ=100

# Matter clusters: exclude Closure Control/Dimension (Matter 1.5, unused by
# this contact sensor). Their bundled connectedhomeip code fails to build
# with missing operator== on GenericOverallCurrentState/TargetState in both
# esp_matter 1.4.2 and 1.5.0 -- see espressif/esp-matter#1604. Excluding the
# source dirs via cluster_dir.cmake avoids the bug entirely, regardless of
# esp_matter version.
CONFIG_SUPPORT_CLOSURE_CONTROL_CLUSTER=n
CONFIG_SUPPORT_CLOSURE_DIMENSION_CLUSTER=n
```

## MiniSplit/sdkconfig.defaults
```kconfig
# Flash / partition table
# The Matter + Tuya HTTP client + BME280 + esp_matter's bundled diagnostics
# components build to ~1.8MB, which doesn't fit ESP-IDF's default single-app
# partition table (1MB). Use this project's own partitions.csv (3MB factory
# partition) on a 4MB flash chip instead.
CONFIG_ESPTOOLPY_FLASHSIZE_4MB=y
CONFIG_ESPTOOLPY_FLASHSIZE="4MB"
CONFIG_PARTITION_TABLE_CUSTOM=y
CONFIG_PARTITION_TABLE_CUSTOM_FILENAME="partitions.csv"
CONFIG_PARTITION_TABLE_FILENAME="partitions.csv"

# mbedTLS (required by the Matter stack)
# Matter's crypto layer (CHIPCryptoPALmbedTLS.cpp) calls mbedtls_hkdf
# directly; mbedTLS ships it disabled by default.
CONFIG_MBEDTLS_HKDF_C=y

# Matter clusters: exclude Closure Control/Dimension (Matter 1.5, unused by
# this mini-split bridge). Their bundled connectedhomeip code fails to build
# with missing operator== on GenericOverallCurrentState/TargetState in both
# esp_matter 1.4.2 and 1.5.0 -- see espressif/esp-matter#1604. Excluding them
# avoids the bug entirely, regardless of esp_matter version.
CONFIG_SUPPORT_CLOSURE_CONTROL_CLUSTER=n
CONFIG_SUPPORT_CLOSURE_DIMENSION_CLUSTER=n

# Network transport: Thread, not WiFi. This device now joins the Matter
# fabric over Thread (via the OTBR running on the home server) instead of
# pre-connecting to WiFi with baked-in credentials -- the Thread Operational
# Dataset is handed to the device by the commissioner (Home Assistant, via
# OTBR) during BLE commissioning, the standard way Matter's Network
# Commissioning cluster works for Thread devices. See src/main.c for the
# corresponding boot-sequence change.
CONFIG_OPENTHREAD_ENABLED=y
CONFIG_ENABLE_MATTER_OVER_THREAD=y
# CONFIG_ENABLE_WIFI_STATION is not set

# Bluetooth (NimBLE only -- required for Matter/BLE commissioning, see
# BUILD.md "Bluetooth: NimBLE only" section). This was previously only ever
# set via manual menuconfig clicks in the original WiFi/BLE build and never
# captured here -- an `idf.py fullclean` regenerates sdkconfig from defaults
# only, and BT_ENABLED defaults to off on this target, so a fullclean
# silently produced a build with no Bluetooth at all. Confirmed on real
# hardware: `grep BT_ENABLED sdkconfig` came back "# CONFIG_BT_ENABLED is
# not set" after a fullclean rebuild, and the device never advertised BLE.
CONFIG_BT_ENABLED=y
CONFIG_BT_BLE_ENABLED=y
CONFIG_BT_NIMBLE_ENABLED=y
# CONFIG_BT_BLUEDROID_ENABLED is not set

# BLE advertising must be told to autostart on power-up -- it defaults to 0
# (off) in connectedhomeip's Kconfig ("BLE Options" -> "Enable CHIPoBLE
# advertising start automatically after device power-up"). Without this,
# esp_matter::start() opens the commissioning window (QR code/setup code get
# printed, mDNS advertises over Thread) but never actually starts the BLE
# radio advertising, so the device is invisible to a BLE scan even though
# everything else looks like it's running fine. Found by direct hardware
# testing -- the device printed onboarding codes but never showed up in a
# BLE scan from the commissioning host.
CONFIG_CHIPOBLE_ENABLE_ADVERTISING_AUTOSTART=1
#
# Confirmed via real hardware: menuconfig resolved this to CONFIG_OPENTHREAD_FTD=y
# on its own (Full Thread Device -- correct for this mains-powered device).

# DNS64 client: without this, the device has no way to resolve an IPv4
# hostname (e.g. "pool.ntp.org" for SNTP, or Tuya's API hostname later) into
# a NAT64-synthesized address it can actually route to over Thread -- it can
# have perfectly working NAT44/masquerade border routing on the OTBR side
# and still fail every hostname-based connection. Confirmed missing on real
# hardware (sdkconfig showed "# CONFIG_OPENTHREAD_DNS64_CLIENT is not set")
# while chasing a repeated SNTP-timeout crash after Thread join succeeded.
CONFIG_OPENTHREAD_DNS64_CLIENT=y

# Operational service discovery: use OpenThread's SRP client (registers with
# OTBR, which bridges to real LAN mDNS) instead of CHIP's own "minimal mDNS"
# advertiser, which defaults to on (CONFIG_USE_MINIMAL_MDNS=y) and sends raw
# mDNS multicast directly over the Thread mesh interface -- traffic that
# never crosses the border router, so a commissioner on the LAN can never
# see it. CHIP_DEVICE_CONFIG_ENABLE_THREAD_SRP_CLIENT (which actually gates
# the SRP-based advertiser in connectedhomeip's ESP32 Dnssd backend) maps
# 1:1 to this Kconfig symbol and is NOT implied by CONFIG_OPENTHREAD_ENABLED
# -- it's a separate, easy-to-miss toggle. Confirmed on real hardware: with
# only CONFIG_USE_MINIMAL_MDNS=y (the default) and no SRP client, the device
# joined Thread and worked completely normally (DNS/NTP/HTTPS to Tuya's
# cloud API all fine) since none of that depends on being *discoverable* --
# but OTBR's SRP server never received a single registration, and a Matter
# commissioner's final "operational discovery" step timed out on every
# attempt (3 retries, ~2.5 minutes) even though the device was fully up the
# entire time -- the commissioning UI reported failure while the device
# quietly kept working. If USE_MINIMAL_MDNS is disabled without also
# enabling SRP client, every DNS-SD call in this build compiles to a no-op
# (neither branch of ESP32/DnssdImpl.cpp's #if is taken for a Thread-only,
# non-WiFi build) -- both settings below must change together.
CONFIG_OPENTHREAD_SRP_CLIENT=y
# CONFIG_USE_MINIMAL_MDNS is not set
```
